## Kconfig
```kconfig
config LAYOUT_SHIFT
    bool "Layout Shift"
    default y

if LAYOUT_SHIFT

config LAYOUT_SHIFT_MAX_PRESSED_KEYS
    int "Maximum tracked layout shift key presses"
    default 16
    range 1 255

config LAYOUT_SHIFT_DEBUG
    bool "Layout Shift debug logging"
    depends on LOG

config LAYOUT_SHIFT_PERSISTENT_STATE
    bool "Layout Shift Persistent State"
    default y
    select SETTINGS

endif

config UNIVERSAL_DONGLE_CATALOG
    bool "Compile experimental dual keyboard configuration catalogue"
    default n
    help
      Data-only Hana/Chocofi Studio snapshot catalogue for memory sizing.
      Does not change BLE routing or ZMK's active keymap.
```

## boards/shields/corne/Kconfig.defconfig
```kconfig
# SPDX-License-Identifier: MIT
if SHIELD_CORNE_CENTRAL_DONGLE || SHIELD_CORNE_CENTRAL_DONGLE_128X64 || SHIELD_CORNE_CENTRAL_DONGLE_128X32 || SHIELD_CORNE_CENTRAL_LEFT
config ZMK_SPLIT_ROLE_CENTRAL
    default y
endif
if SHIELD_CORNE_CENTRAL_DONGLE || SHIELD_CORNE_CENTRAL_DONGLE_128X64 || SHIELD_CORNE_CENTRAL_DONGLE_128X32
config ZMK_KEYBOARD_NAME
    default "corne.dongle"
endif
if SHIELD_CORNE_CENTRAL_LEFT
config ZMK_KEYBOARD_NAME
    default "corne.central"
endif
if SHIELD_CORNE_PERIPHERAL_LEFT
config ZMK_KEYBOARD_NAME
    default "corne.left"
endif
if SHIELD_CORNE_PERIPHERAL_RIGHT
config ZMK_KEYBOARD_NAME
    default "corne.right"
endif
if SHIELD_CORNE_CENTRAL_DONGLE || SHIELD_CORNE_CENTRAL_DONGLE_128X64 || SHIELD_CORNE_CENTRAL_DONGLE_128X32 || SHIELD_CORNE_CENTRAL_LEFT || SHIELD_CORNE_PERIPHERAL_LEFT || SHIELD_CORNE_PERIPHERAL_RIGHT
config ZMK_SPLIT
    default y
config ZMK_SLEEP
    default y
if ZMK_DISPLAY
config I2C
    default y
config SSD1306
    default y
endif
if LVGL
config LV_Z_VDB_SIZE
    default 64
config LV_DPI_DEF
    default 148
config LV_Z_BITS_PER_PIXEL
    default 1
choice LV_COLOR_DEPTH
    default LV_COLOR_DEPTH_1
endchoice
endif
endif
```

## boards/shields/corne/Kconfig.shield
```kconfig
# SPDX-License-Identifier: MIT
config SHIELD_CORNE_CENTRAL_DONGLE
    def_bool $(shields_list_contains,corne_central_dongle)
config SHIELD_CORNE_CENTRAL_DONGLE_128X64
    def_bool $(shields_list_contains,corne_central_dongle_128x64)
config SHIELD_CORNE_CENTRAL_DONGLE_128X32
    def_bool $(shields_list_contains,corne_central_dongle_128x32)
config SHIELD_CORNE_CENTRAL_LEFT
    def_bool $(shields_list_contains,corne_central_left)
config SHIELD_CORNE_PERIPHERAL_LEFT
    def_bool $(shields_list_contains,corne_peripheral_left)
config SHIELD_CORNE_PERIPHERAL_RIGHT
    def_bool $(shields_list_contains,corne_peripheral_right)
```

## boards/shields/sofle/Kconfig.defconfig
```kconfig
# SPDX-License-Identifier: MIT
if SHIELD_SOFLE_CENTRAL_DONGLE || SHIELD_SOFLE_CENTRAL_DONGLE_128X64 || SHIELD_SOFLE_CENTRAL_DONGLE_128X32 || SHIELD_SOFLE_CENTRAL_LEFT
config ZMK_SPLIT_ROLE_CENTRAL
    default y
endif
if SHIELD_SOFLE_CENTRAL_DONGLE || SHIELD_SOFLE_CENTRAL_DONGLE_128X64 || SHIELD_SOFLE_CENTRAL_DONGLE_128X32
config ZMK_KEYBOARD_NAME
    default "sofle.dongle"
endif
if SHIELD_SOFLE_CENTRAL_LEFT
config ZMK_KEYBOARD_NAME
    default "sofle.central"
endif
if SHIELD_SOFLE_PERIPHERAL_LEFT
config ZMK_KEYBOARD_NAME
    default "sofle.left"
endif
if SHIELD_SOFLE_PERIPHERAL_RIGHT
config ZMK_KEYBOARD_NAME
    default "sofle.right"
endif
if SHIELD_SOFLE_CENTRAL_DONGLE || SHIELD_SOFLE_CENTRAL_DONGLE_128X64 || SHIELD_SOFLE_CENTRAL_DONGLE_128X32 || SHIELD_SOFLE_CENTRAL_LEFT || SHIELD_SOFLE_PERIPHERAL_LEFT || SHIELD_SOFLE_PERIPHERAL_RIGHT
config ZMK_SPLIT
    default y
config ZMK_SLEEP
    default y
config EC11
    default y
choice EC11_TRIGGER_MODE
    default EC11_TRIGGER_GLOBAL_THREAD
    depends on EC11
endchoice
if ZMK_DISPLAY
config I2C
    default y
config SSD1306
    default y
endif
if LVGL
config LV_Z_VDB_SIZE
    default 64
config LV_DPI_DEF
    default 148
config LV_Z_BITS_PER_PIXEL
    default 1
choice LV_COLOR_DEPTH
    default LV_COLOR_DEPTH_1
endchoice
endif
endif
```

## boards/shields/sofle/Kconfig.shield
```kconfig
# SPDX-License-Identifier: MIT
config SHIELD_SOFLE_CENTRAL_DONGLE
    def_bool $(shields_list_contains,sofle_central_dongle)
config SHIELD_SOFLE_CENTRAL_DONGLE_128X64
    def_bool $(shields_list_contains,sofle_central_dongle_128x64)
config SHIELD_SOFLE_CENTRAL_DONGLE_128X32
    def_bool $(shields_list_contains,sofle_central_dongle_128x32)
config SHIELD_SOFLE_CENTRAL_LEFT
    def_bool $(shields_list_contains,sofle_central_left)
config SHIELD_SOFLE_PERIPHERAL_LEFT
    def_bool $(shields_list_contains,sofle_peripheral_left)
config SHIELD_SOFLE_PERIPHERAL_RIGHT
    def_bool $(shields_list_contains,sofle_peripheral_right)
```

## boards/shields/sweep/Kconfig.defconfig
```kconfig
# SPDX-License-Identifier: MIT

if SHIELD_SWEEP_CENTRAL_DONGLE || SHIELD_SWEEP_CENTRAL_DONGLE_128X64 || SHIELD_SWEEP_CENTRAL_DONGLE_128X32 || SHIELD_SWEEP_CENTRAL_LEFT
config ZMK_SPLIT_ROLE_CENTRAL
    default y
endif

if SHIELD_SWEEP_CENTRAL_DONGLE || SHIELD_SWEEP_CENTRAL_DONGLE_128X64 || SHIELD_SWEEP_CENTRAL_DONGLE_128X32
config ZMK_KEYBOARD_NAME
    default "sweep.dongle"
endif

if SHIELD_SWEEP_CENTRAL_LEFT
config ZMK_KEYBOARD_NAME
    default "sweep.central"
endif

if SHIELD_SWEEP_PERIPHERAL_LEFT
config ZMK_KEYBOARD_NAME
    default "sweep.left"
endif

if SHIELD_SWEEP_PERIPHERAL_RIGHT
config ZMK_KEYBOARD_NAME
    default "sweep.right"
endif

if SHIELD_SWEEP_CENTRAL_DONGLE || SHIELD_SWEEP_CENTRAL_DONGLE_128X64 || SHIELD_SWEEP_CENTRAL_DONGLE_128X32 || SHIELD_SWEEP_CENTRAL_LEFT || SHIELD_SWEEP_PERIPHERAL_LEFT || SHIELD_SWEEP_PERIPHERAL_RIGHT
config ZMK_SPLIT
    default y

config ZMK_SLEEP
    default y

if ZMK_DISPLAY
config I2C
    default y

config SSD1306
    default y
endif

if LVGL
config LV_Z_VDB_SIZE
    default 64

config LV_DPI_DEF
    default 148

config LV_Z_BITS_PER_PIXEL
    default 1

choice LV_COLOR_DEPTH
    default LV_COLOR_DEPTH_1
endchoice
endif

endif
```

## boards/shields/sweep/Kconfig.shield
```kconfig
# Copyright (c) 2020 The ZMK Contributors
# SPDX-License-Identifier: MIT

config SHIELD_SWEEP_CENTRAL_DONGLE
    def_bool $(shields_list_contains,sweep_central_dongle)

config SHIELD_SWEEP_CENTRAL_DONGLE_128X64
    def_bool $(shields_list_contains,sweep_central_dongle_128x64)

config SHIELD_SWEEP_CENTRAL_DONGLE_128X32
    def_bool $(shields_list_contains,sweep_central_dongle_128x32)

config SHIELD_SWEEP_CENTRAL_LEFT
    def_bool $(shields_list_contains,sweep_central_left)

config SHIELD_SWEEP_PERIPHERAL_LEFT
    def_bool $(shields_list_contains,sweep_peripheral_left)

config SHIELD_SWEEP_PERIPHERAL_RIGHT
    def_bool $(shields_list_contains,sweep_peripheral_right)
```

## dts/bindings/behaviors/zmk,behavior-oled-brightness.yaml
```yaml
description: Adjust SSD1306 OLED panel contrast (perceived brightness)

compatible: "zmk,behavior-oled-brightness"

include: one_param.yaml
```
