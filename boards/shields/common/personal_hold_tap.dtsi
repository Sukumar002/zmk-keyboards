/*
 * Authoritative hold-tap timing for the keyboard family.
 *
 * Use ZMK's built-in &mt instance with the shared timing and decision policy.
 * Layer-Tap uses hold-preferred so a following key-down can trigger the hold
 * immediately; keep timing values aligned with Mod-Tap.
 *
 * 200 ms tapping term, 175 ms quick-tap term, prior-idle disabled.
 */

&mt {
    flavor = "balanced";
    tapping-term-ms = <200>;
    quick-tap-ms = <175>;
    require-prior-idle-ms = <(-1)>;
};

&lt {
    flavor = "hold-preferred";
    tapping-term-ms = <200>;
    quick-tap-ms = <175>;
    require-prior-idle-ms = <(-1)>;
    display-name = "Layer-Tap";
};
