#include "chocofi_central_dongle.overlay"
/ { chosen { zephyr,display = &oled_dongle; }; };
&pro_micro_i2c {
    status = "okay";
    oled_dongle: ssd1306@3c {
        /* Match Hana 128x64: override inherited 128x32 panel-specific flags. */
        /delete-property/ inversion-on;
        /delete-property/ com-sequential;
        compatible = "solomon,ssd1306fb";
        reg = <0x3c>;
        width = <128>;
        height = <64>;
        segment-offset = <0>;
        page-offset = <0>;
        display-offset = <0>;
        multiplex-ratio = <63>;
        segment-remap;
        com-invdir;
        prechargep = <0x22>;
    };
};
