#include "chocofi.dtsi"

&kscan0 {
    // Preserve the mirrored left-hand scan order for the five-column transform.
    col-gpios = <&pro_micro 21 GPIO_ACTIVE_HIGH>, <&pro_micro 20 GPIO_ACTIVE_HIGH>, <&pro_micro 19 GPIO_ACTIVE_HIGH>, <&pro_micro 18 GPIO_ACTIVE_HIGH>, <&pro_micro 15 GPIO_ACTIVE_HIGH>, <&pro_micro 14 GPIO_ACTIVE_HIGH>;
};
