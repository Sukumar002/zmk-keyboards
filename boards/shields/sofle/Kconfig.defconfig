## boards/shields/sofle/Kconfig.defconfig
```kconfig
# SPDX-License-Identifier: MIT
if SHIELD_SOFLE_CENTRAL_DONGLE || SHIELD_SOFLE_CENTRAL_DONGLE_128X64 || SHIELD_SOFLE_CENTRAL_DONGLE_128X32 || SHIELD_SOFLE_CENTRAL_LEFT
config ZMK_SPLIT_ROLE_CENTRAL
    default y
endif
if SHIELD_SOFLE_CENTRAL_DONGLE || SHIELD_SOFLE_CENTRAL_DONGLE_128X64 || SHIELD_SOFLE_CENTRAL_DONGLE_128X32
config ZMK_KEYBOARD_NAME
    default "sofle.dongle"
endif
if SHIELD_SOFLE_CENTRAL_LEFT
config ZMK_KEYBOARD_NAME
    default "sofle.central"
endif
if SHIELD_SOFLE_PERIPHERAL_LEFT
config ZMK_KEYBOARD_NAME
    default "sofle.left"
endif
if SHIELD_SOFLE_PERIPHERAL_RIGHT
config ZMK_KEYBOARD_NAME
    default "sofle.right"
endif
if SHIELD_SOFLE_CENTRAL_DONGLE || SHIELD_SOFLE_CENTRAL_DONGLE_128X64 || SHIELD_SOFLE_CENTRAL_DONGLE_128X32 || SHIELD_SOFLE_CENTRAL_LEFT || SHIELD_SOFLE_PERIPHERAL_LEFT || SHIELD_SOFLE_PERIPHERAL_RIGHT
config ZMK_SPLIT
    default y
config ZMK_SLEEP
    default y
config EC11
    default y
choice EC11_TRIGGER_MODE
    default EC11_TRIGGER_GLOBAL_THREAD
    depends on EC11
endchoice
if ZMK_DISPLAY
config I2C
    default y
config SSD1306
    default y
endif
# Preserve the existing display defaults for every Sofle target except the
# isolated 128x64 dongle, which follows the physically tested Sweep defaults.
if LVGL && !SHIELD_SOFLE_CENTRAL_DONGLE_128X64
config LV_Z_VDB_SIZE
    default 64
config LV_DPI_DEF
    default 148
config LV_Z_BITS_PER_PIXEL
    default 1
choice LV_COLOR_DEPTH
    default LV_COLOR_DEPTH_1
endchoice
endif
endif
```

## config/west.yml
```yaml
manifest:
  remotes:
    - name: zmkfirmware
      url-base: https://github.com/zmkfirmware

    - name: sukumar
      url-base: https://github.com/Sukumar002

  projects:
    - name: zmk
      remote: sukumar
      revision: 079b9fe5272e4679308d0c3d9b79bc08de57c470
      import: app/west.yml

    - name: zmk-dongle-display
      remote: sukumar
      revision: 0647173d2c4416366454f8a2632f2b1bcd04b5dd

  self:
    path: config
```
