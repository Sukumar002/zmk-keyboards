#include "sofle_central_dongle.overlay"

/*
 * Match the controller properties of the physically tested Sweep 128x64
 * dongle exactly. The base Sofle DTSI enables COM sequential mode and display
 * inversion for its 128x32 panel; explicitly remove both inherited properties
 * for this 128x64 SSD1306 configuration.
 *
 * Reuse the existing SSD1306 node to avoid duplicate-address node merging.
 */
&oled {
    /delete-property/ com-sequential;
    /delete-property/ inversion-on;

    width = <128>;
    height = <64>;
    segment-offset = <0>;
    page-offset = <0>;
    display-offset = <0>;
    multiplex-ratio = <63>;
    segment-remap;
    com-invdir;
    prechargep = <0x22>;
    status = "okay";
};

/ {
    chosen {
        zephyr,display = &oled;
    };
};

#include "sofle_battery.dtsi"
#include "sofle_studio_output_alias.dtsi"
